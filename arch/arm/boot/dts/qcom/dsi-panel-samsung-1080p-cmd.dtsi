/* Copyright (c) 2013, The Linux Foundation. All rights reserved.
 *
 * This program is free software; you can redistribute it and/or modify
 * it under the terms of the GNU General Public License version 2 and
 * only version 2 as published by the Free Software Foundation.
 *
 * This program is distributed in the hope that it will be useful,
 * but WITHOUT ANY WARRANTY; without even the implied warranty of
 * MERCHANTABILITY or FITNESS FOR A PARTICULAR PURPOSE.  See the
 * GNU General Public License for more details.
 */

/*---------------------------------------------------------------------------
 * This file is autogenerated file using gcdb parser. Please do not edit it.
 * Update input XML file to add a new entry or update variable in this file
 * VERSION = "1.0"
 *---------------------------------------------------------------------------*/
&mdss_mdp {
	dsi_samsung_1080p_cmd: qcom,mdss_dsi_samsung_1080p_cmd {
		qcom,mdss-dsi-panel-name = "samsung 1080p command mode dsi panel";
		qcom,mdss-dsi-panel-controller = <&mdss_dsi0>;
		qcom,mdss-dsi-panel-type = "dsi_cmd_mode";
		qcom,mdss-dsi-panel-destination = "display_1";
		qcom,mdss-dsi-panel-framerate = <60>;
                qcom,mdss-dsi-panel-orientation = "180";
		qcom,mdss-dsi-virtual-channel-id = <0>;
		qcom,mdss-dsi-stream = <0>;
		qcom,mdss-dsi-panel-width = <1080>;
		qcom,mdss-dsi-panel-height = <1920>;
		qcom,mdss-dsi-h-front-porch = <8>;
		qcom,mdss-dsi-h-back-porch = <8>;
		qcom,mdss-dsi-h-pulse-width = <24>;
		qcom,mdss-dsi-h-sync-skew = <0>;
		qcom,mdss-dsi-v-back-porch = <40>;
		qcom,mdss-dsi-v-front-porch = <4>;
		qcom,mdss-dsi-v-pulse-width = <2>;
		qcom,mdss-dsi-h-left-border = <0>;
		qcom,mdss-dsi-h-right-border = <0>;
		qcom,mdss-dsi-v-top-border = <0>;
		qcom,mdss-dsi-v-bottom-border = <0>;
		qcom,mdss-dsi-bpp = <24>;
		qcom,mdss-dsi-color-order = "rgb_swap_rgb";
		qcom,mdss-dsi-underflow-color = <0xff>;
		qcom,mdss-dsi-border-color = <0>;
		qcom,mdss-dsi-pixel-packing = "tight";
		qcom,mdss-dsi-pixel-alignment = <0>;
                qcom,mdss-pan-physical-width-dimension = <71>;
                qcom,mdss-pan-physical-height-dimension = <126>;
                qcom,mdss-dsi-tx-eot-append;
		qcom,mdss-dsi-on-command = [05 01 00 00 46 00 02 11 00
		      29 01 00 00 00 00 02 35 00
					29 01 00 00 00 00 03 FC 5A 5A
					29 01 00 00 00 00 02 B0 1E
					29 01 00 00 00 00 02 FD 94
					29 01 00 00 46 00 03 FC A5 A5
					05 01 00 00 00 00 02 29 00
					29 01 00 00 00 00 02 53 20
					29 01 00 00 00 00 02 55 00];
		qcom,mdss-dsi-off-command = [05 01 00 00 32 00 02 28 00
					05 01 00 00 78 00 02 10 00];
		qcom,mdss-dsi-alpm-on-command = [05 01 00 00 46 00 02 28 00
					29 00 00 00 00 00 03 F0 5A 5A
					29 00 00 00 00 00 02 B0 03
					29 00 00 00 00 00 02 B8 28
					29 00 00 00 00 00 02 B0 3B
					29 00 00 00 00 00 07 CB 51 38 51 38 01 00
					29 00 00 00 00 00 0A BB C4 00 06 48 D7 00 A8 96 C5
					29 00 00 00 00 00 02 F7 03
					29 00 00 00 00 00 02 53 22
					29 01 00 00 46 00 03 F0 A5 A5
					05 01 00 00 00 00 02 29 00];
		qcom,mdss-dsi-alpm-off-command = [05 01 00 00 46 00 02 28 00
					29 00 00 00 00 00 03 F0 5A 5A
					29 00 00 00 00 00 02 B0 03
					29 00 00 00 00 00 02 B8 28
					29 00 00 00 00 00 02 B0 3B
					29 00 00 00 00 00 07 CB 51 38 51 38 01 00
					29 00 00 00 00 00 0A BB C4 00 06 48 8F 00 B4 A1 D2
					29 00 00 00 00 00 02 F7 03
					29 00 00 00 00 00 02 53 20
					29 01 00 00 46 00 03 F0 A5 A5
					05 01 00 00 00 00 02 29 00];
		qcom,mdss-dsi-alpm-on5-command = [05 01 00 00 46 00 02 28 00
					29 00 00 00 00 00 03 F0 5A 5A
					29 00 00 00 00 00 02 B0 03
					29 00 00 00 00 00 02 B8 28
					29 00 00 00 00 00 02 B0 3B
					29 00 00 00 00 00 07 CB 51 38 51 38 01 00
					29 00 00 00 00 00 0A BB C4 00 06 48 D7 00 A8 96 C5
					29 00 00 00 00 00 02 F7 03
					29 00 00 00 00 00 02 53 23
					29 01 00 00 46 00 03 F0 A5 A5
					05 01 00 00 00 00 02 29 00];
		qcom,mdss-dsi-alpm-change40-command = [29 00 00 00 00 00 03 F0 5A 5A
					29 00 00 00 00 00 02 53 23
					29 00 00 00 00 00 02 B0 02
					29 00 00 00 00 00 04 BB 00 48 48
					29 00 00 00 00 00 02 F7 03
					29 00 00 00 00 00 02 53 22
					29 01 00 00 46 00 03 F0 A5 A5];
		qcom,mdss-dsi-alpm-change5-command = [29 00 00 00 00 00 03 F0 5A 5A
					29 00 00 00 00 00 02 53 23
					29 00 00 00 00 00 02 B0 02
					29 00 00 00 00 00 04 BB 06 48 D7
					29 00 00 00 00 00 02 F7 03
					29 01 00 00 46 00 03 F0 A5 A5];
                qcom,mdss-dsi-vr-on1-command = [29 00 00 00 00 00 03 F0 5A 5A
                                        29 00 00 00 00 00 02 B0 09
                                        29 00 00 00 00 00 08 CB 12 01 00 00 96 05 0D
                                        29 00 00 00 00 00 02 B0 17
                                        29 00 00 00 00 00 02 CB 14
                                        29 00 00 00 00 00 02 B0 2D
                                        29 00 00 00 00 00 02 CB CD
                                        29 00 00 00 00 00 02 B0 3B
                                        29 00 00 00 00 00 05 CB 51 38 51 38
                                        29 00 00 00 00 00 03 B2 10 84
                                        29 00 00 00 00 00 02 B0 05
                                        29 00 00 00 00 00 02 B1 00
                                        29 00 00 00 00 00 02 B0 05
                                        29 00 00 00 00 00 03 F2 11 07
                                        29 00 00 00 00 00 02 F7 03
                                        29 01 00 00 00 00 03 F0 A5 A5];
                qcom,mdss-dsi-vr-on2-command = [29 00 00 00 00 00 03 F0 5A 5A
                                        29 00 00 00 00 00 02 B0 09
                                        29 00 00 00 00 00 08 CB 12 01 00 00 96 05 0D
                                        29 00 00 00 00 00 02 B0 17
                                        29 00 00 00 00 00 02 CB 14
                                        29 00 00 00 00 00 02 B0 2D
                                        29 00 00 00 00 00 02 CB CD
                                        29 00 00 00 00 00 02 B0 3B
                                        29 00 00 00 00 00 05 CB 51 38 51 38
                                        29 00 00 00 00 00 03 B2 10 23
                                        29 00 00 00 00 00 02 B0 05
                                        29 00 00 00 00 00 02 B1 00
                                        29 00 00 00 00 00 02 B0 05
                                        29 00 00 00 00 00 03 F2 11 07
                                        29 00 00 00 00 00 02 F7 03
                                        29 01 00 00 00 00 03 F0 A5 A5];
                qcom,mdss-dsi-vr-on3-command = [29 00 00 00 00 00 03 F0 5A 5A
                                        29 00 00 00 00 00 02 B0 09
                                        29 00 00 00 00 00 08 CB 12 01 00 00 96 05 0D
                                        29 00 00 00 00 00 02 B0 17
                                        29 00 00 00 00 00 02 CB 14
                                        29 00 00 00 00 00 02 B0 2D
                                        29 00 00 00 00 00 02 CB CD
                                        29 00 00 00 00 00 02 B0 3B
                                        29 00 00 00 00 00 05 CB 51 38 51 38
                                        29 00 00 00 00 00 03 B2 00 C2
                                        29 00 00 00 00 00 02 B0 05
                                        29 00 00 00 00 00 02 B1 00
                                        29 00 00 00 00 00 02 B0 05
                                        29 00 00 00 00 00 03 F2 11 07
                                        29 00 00 00 00 00 02 F7 03
                                        29 01 00 00 00 00 03 F0 A5 A5];
                qcom,mdss-dsi-vr-off-command = [29 00 00 00 00 00 03 F0 5A 5A
                                        29 00 00 00 00 00 02 B0 09
                                        29 00 00 00 00 00 08 CB 0A 05 00 00 96 05 05
                                        29 00 00 00 00 00 02 B0 17
                                        29 00 00 00 00 00 02 CB 01
                                        29 00 00 00 00 00 02 B0 2D
                                        29 00 00 00 00 00 02 CB 4D
                                        29 00 00 00 00 00 02 B0 3B
                                        29 00 00 00 00 00 05 CB 0B 70 0B 70
                                        29 00 00 00 00 00 03 B2 00 C2
                                        29 00 00 00 00 00 02 B0 05
                                        29 00 00 00 00 00 02 B1 40
                                        29 00 00 00 00 00 02 B0 05
                                        29 00 00 00 00 00 03 F2 09 07
                                        29 00 00 00 00 00 02 F7 03
                                        29 01 00 00 00 00 03 F0 A5 A5];
		qcom,mdss-dsi-on-command-state = "dsi_lp_mode";
		qcom,mdss-dsi-off-command-state = "dsi_hs_mode";
		qcom,mdss-dsi-lp11-init;
		qcom,mdss-dsi-h-sync-pulse = <1>;
		qcom,mdss-dsi-traffic-mode = "non_burst_sync_event";
		qcom,mdss-dsi-lane-map = "lane_map_0123";
		qcom,mdss-dsi-bllp-eof-power-mode;
		qcom,mdss-dsi-bllp-power-mode;
		qcom,mdss-dsi-lane-0-state;
		qcom,mdss-dsi-lane-1-state;
		qcom,mdss-dsi-lane-2-state;
		qcom,mdss-dsi-lane-3-state;
		qcom,mdss-dsi-te-pin-select = <1>;
		qcom,mdss-dsi-wr-mem-start = <0x2c>;
		qcom,mdss-dsi-wr-mem-continue = <0x3c>;
		qcom,mdss-dsi-te-v-sync-rd-ptr-irq-line = <0x2c>;
		qcom,mdss-dsi-te-dcs-command = <1>;
		qcom,mdss-dsi-te-check-enable;
		qcom,mdss-dsi-te-using-te-pin;
		qcom,ulps-enabled;
		qcom,mdss-dsi-panel-timings = [E0 3C 37 00 5F 59 34 3C 29 04 05 00];
		qcom,mdss-dsi-t-clk-post = <0x7>;
		qcom,mdss-dsi-t-clk-pre = <0x2A>;
		qcom,mdss-dsi-bl-min-level = <1>;
		qcom,mdss-dsi-bl-max-level = <255>;
		qcom,mdss-dsi-dma-trigger = "trigger_sw";
		qcom,mdss-dsi-mdp-trigger = "none";
		qcom,mdss-dsi-bl-pmic-control-type = "bl_ctrl_dcs";
		qcom,mdss-dsi-reset-sequence = <1 10>;
	};
};
