/* Copyright (c) 2013, The Linux Foundation. All rights reserved.
 *
 * This program is free software; you can redistribute it and/or modify
 * it under the terms of the GNU General Public License version 2 and
 * only version 2 as published by the Free Software Foundation.
 *
 * This program is distributed in the hope that it will be useful,
 * but WITHOUT ANY WARRANTY; without even the implied warranty of
 * MERCHANTABILITY or FITNESS FOR A PARTICULAR PURPOSE.  See the
 * GNU General Public License for more details.
 */

/*---------------------------------------------------------------------------
 * This file is autogenerated file using gcdb parser. Please do not edit it.
 * Update input XML file to add a new entry or update variable in this file
 * VERSION = "1.0"
 *---------------------------------------------------------------------------*/
&mdss_mdp {
	dsi_tm_td4300_1080p_video: qcom,mdss_dsi_tm_td4300_1080p_video {
		qcom,mdss-dsi-panel-name = "tm td4300 1080p video mode dsi panel";
		qcom,mdss-dsi-panel-controller = <&mdss_dsi0>;
		qcom,mdss-dsi-panel-type = "dsi_video_mode";
		qcom,mdss-dsi-panel-destination = "display_1";
		qcom,mdss-dsi-panel-framerate = <60>;
		qcom,mdss-dsi-virtual-channel-id = <0>;
		qcom,mdss-dsi-stream = <0>;
		qcom,mdss-dsi-panel-width = <1080>;
		qcom,mdss-dsi-panel-height = <1920>;
		qcom,mdss-dsi-h-front-porch = <24>;
		qcom,mdss-dsi-h-back-porch = <41>;
		qcom,mdss-dsi-h-pulse-width = <2>;
		qcom,mdss-dsi-h-sync-skew = <0>;
		qcom,mdss-dsi-v-back-porch = <4>;
		qcom,mdss-dsi-v-front-porch = <8>;
		qcom,mdss-dsi-v-pulse-width = <1>;
		qcom,mdss-dsi-h-left-border = <0>;
		qcom,mdss-dsi-h-right-border = <0>;
		qcom,mdss-dsi-v-top-border = <0>;
		qcom,mdss-dsi-v-bottom-border = <0>;
		qcom,mdss-dsi-bpp = <24>;
		qcom,mdss-dsi-color-order = "rgb_swap_rgb";
		qcom,mdss-dsi-underflow-color = <0xff>;
		qcom,mdss-dsi-border-color = <0>;
		qcom,mdss-dsi-on-command = [    
			/*29 01 00 00 00 00 02 B0 04
			29 01 00 00 00 00 04 B3 31 00 06
			29 01 00 00 00 00 02 B4 00
			29 01 00 00 00 00 06 B6 33 D3 01 FF FF
			29 01 00 00 00 00 08 B8 57 3D 19 1E 0A 50 50
			29 01 00 00 00 00 08 B9 6F 3D 28 3C 14 C8 C8
			29 01 00 00 00 00 08 BA B5 33 41 64 23 A0 A0
			29 01 00 00 00 00 03 BB 14 14
			29 01 00 00 00 00 03 BC 37 32
			29 01 00 00 00 00 03 BD 64 32
			29 01 00 00 00 00 02 BE 04
			29 01 00 00 00 00 02 C0 00
			29 01 00 00 00 00 2E C1 84 08 00 FF FF 2F 7F FC 37 9B F3 FE 67 CD B9 C6 FE 07 C7 E4 FB C5 1F FF FF 0F 00 00 00 00 00 00 00 00 40 00 62 03 02 03 82 00 01 00 01
			29 01 00 00 00 00 11 C2 01 F7 80 04 64 08 0C 10 00 08 60 00 00 00 00 00
			29 01 00 00 00 00 3F C3 78 77 87 78 70 00 00 00 00 00 3C 33 C3 3C 30 3C 43 C4 3C 40 01 01 03 28 00 01 03 01 10 00 13 00 13 00 13 00 13 00 13 00 13 00 13 00 13 00 13 00 26 00 26 00 26 00 26 00 26 00 26 00 40 20
			29 01 00 00 00 00 11 C4 70 00 00 00 00 00 00 00 00 02 02 31 01 00 00 00
			29 01 00 00 00 00 08 C5 10 00 00 00 00 70 00
			29 01 00 00 00 00 17 C6 5F 05 55 02 55 01 0E 01 02 01 02 01 02 01 02 01 02 05 15 07 7F FF
			29 01 00 00 00 00 1F C7 08 14 1B 24 31 3D 45 52 34 3C 48 56 61 6B 7A 08 14 1B 24 31 3D 45 52 34 3C 48 56 61 6B 7A 
			29 01 00 00 00 00 2C CA 1C FC FC FC 00 00 00 00 00 00 00 00 00 00 00 00 00 00 00 00 00 00 00 00 00 00 00 00 00 00 00 00 00 00 00 00 00 00 00 00 00 00 00
			29 01 00 00 00 00 12 CB 50 9F 9F AF 00 00 02 00 04 00 00 00 00 00 00 00 00
			29 01 00 00 00 00 02 CC 0B
			29 01 00 00 00 00 14 CD 09 00 22 00 22 00 22 00 A3 A3 A0 A0 A0 A0 A0 A0 15 00 00
			29 01 00 00 00 00 1A CE 5D 40 49 53 59 5E 63 68 6E 74 7E 8A 98 A8 BB D0 FF 04 00 04 04 42 00 69 5A
			29 01 00 00 00 00 03 CF 48 10
			29 01 00 00 00 00 12 D0 33 54 D4 31 01 10 10 10 19 19 00 00 00 00 00 00 00 
			29 01 00 00 00 00 02 D1 00
			29 01 00 00 00 00 15 D3 1B 3B BB 77 77 77 BB B3 33 00 00 60 66 C1 C1 33 BB F2 FD C6
			29 01 00 00 00 00 08 D5 03 00 00 00 45 00 45
			29 01 00 00 00 00 02 D6 C1
			29 01 00 00 00 00 22 D7 F6 FF 03 05 41 24 80 1F C7 1F 1B 00 0C 07 20 00 00 00 00 00 0C F0 1F 00 0C 00 00 AA 67 7E 5D 06 00 
			29 01 00 00 00 00 03 D9 00 00
			29 01 00 00 00 00 05 DE 00 3F FF 90
			29 01 00 00 10 00 03 F1 00 00*/
			//39 01 00 00 00 00 02 51 FF   
			05 01 00 00 00 00 02 29 00
			05 01 00 00 78 00 02 11 00];
		qcom,mdss-dsi-off-command = [05 01 00 00 32 00 02 28 00
					05 01 00 00 78 00 02 10 00];
		qcom,mdss-dsi-on-command-state = "dsi_hs_mode";
		qcom,mdss-dsi-off-command-state = "dsi_hs_mode";
		qcom,mdss-dsi-h-sync-pulse = <1>;
		qcom,mdss-dsi-traffic-mode = "burst_mode";
		qcom,mdss-dsi-lane-map = "lane_map_0123";
		qcom,mdss-dsi-bllp-eof-power-mode;
		qcom,mdss-dsi-bllp-power-mode;
		qcom,mdss-dsi-tx-eot-append;
		qcom,ulps-enabled;
		qcom,suspend-ulps-enabled;
		qcom,esd-check-enabled; 
		qcom,mdss-dsi-panel-status-command = [06 01 00 01 05 00 02 53 00];
		qcom,mdss-dsi-panel-status-command-state = "dsi_lp_mode";
		qcom,mdss-dsi-panel-status-check-mode = "reg_read";
		qcom,mdss-dsi-panel-status-read-length = <1>;
		qcom,mdss-dsi-panel-max-error-count = <3>;
		qcom,mdss-dsi-panel-status-value = <0x2c>;
		qcom,mdss-dsi-lane-0-state;
		qcom,mdss-dsi-lane-1-state;
		qcom,mdss-dsi-lane-2-state;
		qcom,mdss-dsi-lane-3-state;
		qcom,mdss-dsi-panel-timings = [E6 38 26 00 68 6c 2A 3C 2C 03 04 00];
		qcom,mdss-dsi-t-clk-post = <0x0D>;
		qcom,mdss-dsi-t-clk-pre = <0x2D>;
		qcom,mdss-dsi-bl-min-level = <1>;
		qcom,mdss-dsi-bl-max-level = <4095>;
		qcom,mdss-dsi-dma-trigger = "trigger_sw";
		qcom,mdss-dsi-mdp-trigger = "none";
		qcom,mdss-dsi-bl-pmic-control-type = "bl_ctrl_dcs";
		qcom,mdss-dsi-reset-sequence = <0 10>, <0 10>, <1 150>;
		qcom,mdss-pan-physical-width-dimension=<68>;
		qcom,mdss-pan-physical-height-dimension=<121>;
	};
};
