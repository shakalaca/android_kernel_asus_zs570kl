## drivers/fingerprint/Kconfig
```kconfig
source "drivers/fingerprint/synaptics/Kconfig"

source "drivers/fingerprint/goodix/Kconfig"

config FINGERPRINT
	tristate "Support for fingerprint sensor function"
	help
	  Say Y here to enable fingerprint sensor function
```

## drivers/fingerprint/goodix/Kconfig
```kconfig
config FINGERPRINT_GOODIX316M
	tristate "Goodix OEM fingerprint drvier support"
	help
	  Say Y here to enable goodix fingerprint driver support!
```

## drivers/fingerprint/synaptics/Kconfig
```kconfig
config FINGERPRINT_SYNAPTICS
	tristate "Support for synaptics fingerprint sensor devices"
	help
	  Say Y here to enable synaptics fingerprint sensor device
	  
```

## drivers/media/radio/si4709/Kconfig
```kconfig
config I2C_SI4709
	tristate "Silicon Labs Si4709 FM Radio Receiver support with I2C"
	depends on I2C && RADIO_SI4709
	---help---
	  This is a driver for I2C devices with the Silicon Labs SI4709
	  chip.

	  Say Y here if you want to connect this type of radio to your
	  computer's I2C port.

	  To compile this driver as a module, choose M here: the
	  module will be called radio-i2c-si4709.
```

## drivers/usb/asus_usb/Kconfig
```kconfig
config USB_FUSB302
	bool "USB FUSB302 driver"
        default y
	---help---
	  USB FUSB302 driver.
	  
config TYPEC
	bool "support Type C feature"
	default y
	---help---
	  Say Y here to support Type C feature
```
